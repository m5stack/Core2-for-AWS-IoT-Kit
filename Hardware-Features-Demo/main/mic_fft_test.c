#include <string.h>

#include "freertos/FreeRTOS.h"
#include "freertos/task.h"
#include "freertos/semphr.h"
#include "freertos/queue.h"

#include "math.h"
#include "fft.h"
#include "core2forAWS.h"

const unsigned char ImageData[768] = { 
 0x00 , 0x00 , 0x00 , 0x00 , 0x00 , 0x00 , 0x00 , 0x00 , 0x00 , 0x00 , 0x00 , 0x01 , 0x00 , 0x00 , 0x04 , 0x00 , 
 0x01 , 0x07 , 0x00 , 0x01 , 0x09 , 0x00 , 0x01 , 0x0D , 0x00 , 0x02 , 0x10 , 0x00 , 0x02 , 0x14 , 0x00 , 0x01 , 
 0x17 , 0x00 , 0x02 , 0x1C , 0x00 , 0x02 , 0x20 , 0x00 , 0x02 , 0x24 , 0x00 , 0x03 , 0x28 , 0x00 , 0x03 , 0x2D , 
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 0xF0 , 0xFD , 0xFF , 0xF3 , 0xFE , 0xFF , 0xF6 , 0xFE , 0xFF , 0xF8 , 0xFF , 0xFF , 0xFB , 0xFF , 0xFF , 0xFD , 
};

long map(long x, long in_min, long in_max, long out_min, long out_max) {
    long divisor = (in_max - in_min);
    if(divisor == 0){
        return -1; //AVR returns -1, SAM returns 0
    }
    return (x - in_min) * (out_max - out_min) / divisor + out_min;
}

static uint16_t posData = 159;

QueueHandle_t queue = NULL;

#define CANVAS_WIDTH 240
#define CANVAS_HEIGHT 60

void fftShowtask(void *arg) {
    uint16_t colorPos;
    uint8_t *fft_dis_buff;

    xSemaphoreTake(xGuiSemaphore, portMAX_DELAY);
    lv_obj_t *canvas = lv_canvas_create(lv_scr_act(), NULL);
    lv_obj_set_pos(canvas, 40, 170);
    lv_color_t *cbuf = heap_caps_malloc(LV_CANVAS_BUF_SIZE_TRUE_COLOR(CANVAS_WIDTH, CANVAS_HEIGHT), MALLOC_CAP_DEFAULT | MALLOC_CAP_SPIRAM);
    lv_canvas_set_buffer(canvas, cbuf, CANVAS_WIDTH, CANVAS_HEIGHT, LV_IMG_CF_TRUE_COLOR);
    lv_canvas_fill_bg(canvas, LV_COLOR_BLACK, LV_OPA_COVER);
    xSemaphoreGive(xGuiSemaphore);
    
    for (;;) {
        xQueueReceive(queue, &fft_dis_buff, portMAX_DELAY);
        for (uint16_t count_y = 0; count_y < CANVAS_HEIGHT; count_y++) {
            colorPos = fft_dis_buff[count_y];
            lv_canvas_set_px(canvas, posData, count_y, LV_COLOR_MAKE(ImageData[colorPos * 3 + 0], ImageData[colorPos * 3 + 1], ImageData[colorPos * 3 + 2]));
        }
        free(fft_dis_buff);
        posData += 1;
        if (posData == CANVAS_WIDTH) {
            posData = 0;
        }
    }
}

void microphoneTask(void *arg) {
    static int8_t i2s_readraw_buff[1024];
    size_t bytesread;
    int16_t *buffptr;
    double data = 0;
    uint8_t *fft_dis_buff = NULL;
    Microphone_Init();
    queue = xQueueCreate(2, sizeof(uint8_t *));

    xTaskCreatePinnedToCore(fftShowtask, "fftShowtask", 4096*2, NULL, 1, NULL, 1);

    for (;;) {
        fft_dis_buff = (uint8_t *)heap_caps_malloc(CANVAS_HEIGHT * sizeof(uint8_t), MALLOC_CAP_DEFAULT | MALLOC_CAP_SPIRAM);
        memset(fft_dis_buff, 0, CANVAS_HEIGHT);
        fft_config_t *real_fft_plan = fft_init(512, FFT_REAL, FFT_FORWARD, NULL, NULL);
        i2s_read(I2S_NUM_0, (char *)i2s_readraw_buff, 1024, &bytesread, pdMS_TO_TICKS(100));
        buffptr = (int16_t *)i2s_readraw_buff;
        for (uint16_t count_n = 0; count_n < real_fft_plan->size; count_n++) {
            real_fft_plan->input[count_n] = (float)map(buffptr[count_n], INT16_MIN, INT16_MAX, -1000, 1000);
        }
        fft_execute(real_fft_plan);

        for (uint16_t count_n = 1; count_n < CANVAS_HEIGHT; count_n++) {
            data = sqrt(real_fft_plan->output[2 * count_n] * real_fft_plan->output[2 * count_n] + real_fft_plan->output[2 * count_n + 1] * real_fft_plan->output[2 * count_n + 1]);
            fft_dis_buff[CANVAS_HEIGHT - count_n]  = map(data, 0, 2000, 0, 256);
        }
        fft_destroy(real_fft_plan);
        if(xQueueSend(queue, &fft_dis_buff, 0) == pdFAIL) {
            free(fft_dis_buff);
        }
    }
}