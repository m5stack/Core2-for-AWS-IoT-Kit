## Blinky-Hello-World/components/esp-cryptoauthlib/Kconfig
```kconfig
menu "esp-cryptoauthlib"

    choice ATECC608A_TYPE
        prompt "Choose the type of ATECC608A chip"
        default ATECC608A_TNG
        help
            There are three types of ATECC608A ( Secure Element) chips, which are
            Trust & GO, TrustFLex and Trust Custom. For more details consult README
            file of esp_cryptoauth_utility which is part of esp-cryptoauthlib component.
        config ATECC608A_TNG
            bool "ATECC608A chip type Trust & GO"
        config ATECC608A_TFLEX
            bool "ATECC608A chip type TrustFlex"
        config ATECC608A_TCUSTOM
            bool "ATECC608A chip type TrustCustom"
    endchoice

    config ATCA_I2C_USE_LEGACY_DRIVER
        bool "Force use of legacy I2C driver"
        default n
        help
            Enable this option if you're using an I2C device that requires the legacy I2C driver and encounter conflicts related to I2C driver usage.
            This will force the use of the legacy driver for ATECC608A communication.

            For ESP-IDF versions < 5.2: Only the legacy I2C driver is available, so this option has no effect.
            For ESP-IDF versions >= 5.2: New I2C driver is in use by default. Enable this option to switch back to the legacy driver if needed.

    config ATCA_MBEDTLS_ECDSA
        bool "Enable Hardware ECDSA keys for mbedTLS (ESP-IDF 5.x only)"
        depends on MBEDTLS_ECDSA_C
        help
            Enable ATECC608 hardware ECDSA integration with mbedTLS using the
            ALT mechanism. This allows using ATECC private keys for TLS client
            authentication and other ECDSA operations.

            NOTE: This option only works with ESP-IDF 5.x (mbedTLS 3.x).
            For ESP-IDF 6.x+ (mbedTLS 4.x), use CONFIG_MBEDTLS_HARDWARE_ATECC
            in the mbedtls component Kconfig instead.

    config ATCA_MBEDTLS_ECDSA_SIGN
        bool "Enable ATECC608A sign operations in mbedTLS"
        depends on ATCA_MBEDTLS_ECDSA
        select MBEDTLS_ATCA_HW_ECDSA_SIGN
        select MBEDTLS_ECP_DP_SECP256R1_ENABLED

    config ATCA_MBEDTLS_ECDSA_VERIFY
        bool "Enable ATECC608A verify operations in mbedTLS"
        depends on ATCA_MBEDTLS_ECDSA
        select MBEDTLS_ATCA_HW_ECDSA_VERIFY
        select MBEDTLS_ECP_DP_SECP256R1_ENABLED

    config ATCA_I2C_SDA_PIN
        int "I2C SDA pin used to communicate with the ATECC608A"
        default 21

    config ATCA_I2C_SCL_PIN
        int "I2C SCL pin used to communicate with the ATECC608A"
        default 22

    config ATCA_I2C_ADDRESS
        hex "I2C device address of the ATECC608A"
        default 0xC0 if ATECC608A_TCUSTOM
        default 0x6C if ATECC608A_TFLEX
        default 0x6A if ATECC608A_TNG

    config ATCA_I2C_BAUD_RATE
        int "I2C baud rate in Hz"
        default 100000
        range 100000 1000000

endmenu # cryptoauthlib
```

## Kconfig
```kconfig
# SPDX-FileCopyrightText: 2022 Rashed Talukder
# SPDX-FileCopyrightText: 2022 M5Stack
# SPDX-License-Identifier: MIT

menu "Core2 for AWS hardware features"
    config SOFTWARE_BSP_SUPPORT
        bool "Enable Board Support Package APIs"
        default y
        help
          Enable the Core2 for AWS BSP. This is required for all other features.

    config SOFTWARE_AUDIO_SUPPORT
        bool "Audio (Speaker & Microphone)"
        depends on SOFTWARE_BSP_SUPPORT
        default y
        help
          Enable audio support including speaker and microphone drivers.

    config CORE2FORAWS_AUDIO_DMA_DESCRIPTORS
        int "Audio I2S DMA descriptor count"
        depends on SOFTWARE_AUDIO_SUPPORT
        range 2 32
        default 4
        help
          Number of I2S DMA buffers for the speaker and microphone. Total
          buffered audio is descriptors x frames / sample rate; the default
          4 x 128 frames holds about 11.6 ms at 44.1 kHz. If the writing task
          is preempted for longer, the speaker underruns and clicks. Each
          extra descriptor costs frames x 4 bytes of internal DMA-capable
          DRAM while audio is enabled.

    config CORE2FORAWS_AUDIO_DMA_FRAMES
        int "Audio I2S DMA frames per descriptor"
        depends on SOFTWARE_AUDIO_SUPPORT
        range 8 1023
        default 128
        help
          Frames in each I2S DMA buffer. One buffer must stay within the
          4092-byte DMA descriptor limit, so frames x 4 bytes (16-bit stereo
          speaker frames) must not exceed 4092. Larger buffers add latency
          but tolerate longer scheduling gaps.

    config SOFTWARE_CRYPTO_SUPPORT
        bool "Cryptographic Encryption"
        depends on SOFTWARE_BSP_SUPPORT
        default y
        help
          Enable ATECC608 secure element support for cryptographic operations.

    config SOFTWARE_DISPLAY_SUPPORT
        bool "Display"
        depends on SOFTWARE_BSP_SUPPORT
        default y
        help
          Enable ILI9342C/ILI9342E display and FT6336 touch controller support.
    rsource "lib/display/Kconfig"

    config SOFTWARE_BUTTON_SUPPORT
        bool "Touch Buttons"
        depends on SOFTWARE_DISPLAY_SUPPORT
        default y
        help
          Enable virtual touch button support on the display.
    rsource "lib/button/Kconfig"

    config SOFTWARE_MOTION_SUPPORT
        bool "6-Axis Motion"
        depends on SOFTWARE_BSP_SUPPORT
        default y
        help
          Enable the MPU6886 (Core2 for AWS) or BMI270 (Core2 for AWS v1.3)
          6-axis IMU with temperature sensor support. The IMU is detected at
          run time.

    config SOFTWARE_RTC_SUPPORT
        bool "Real Time Clock"
        depends on SOFTWARE_BSP_SUPPORT
        default y
        help
          Enable BM8563 real-time clock support.

    config TIME_ZONE
        string "Time Zone"
        default "PST8PDT"
        depends on SOFTWARE_RTC_SUPPORT
        help
            Time zone string in POSIX format (e.g., "PST8PDT", "EST5EDT", "CST6CDT", "MST7MDT")
            PST8PDT automatically handles daylight saving time transitions.

    config SOFTWARE_RGB_LED_SUPPORT
        bool "RGB LEDs"
        depends on SOFTWARE_BSP_SUPPORT
        default y
        help
          Enable SK6812 RGB LED strip control on sides of device.

    config SOFTWARE_SDCARD_SUPPORT
        bool "SD Card"
        depends on SOFTWARE_BSP_SUPPORT
        default y
        help
          Enable SD card support via SPI interface.

    config SOFTWARE_EXPANSION_PORTS_SUPPORT
        bool "Expansion Ports A, B, C"
        depends on SOFTWARE_BSP_SUPPORT
        default y
        help
          Enable expansion port GPIO and I2C access.
        rsource "lib/expports/Kconfig"

    config SOFTWARE_WIFI_SUPPORT
        bool "Wi-Fi Helper"
        depends on SOFTWARE_BSP_SUPPORT
        default y
        help
          Enable the Wi-Fi station helper: scan, connect, saved network, and
          automatic reconnection.

    config CORE2FORAWS_WIFI_RECONNECT_MAX_BACKOFF_S
        int "Maximum automatic reconnect interval (seconds)"
        depends on SOFTWARE_WIFI_SUPPORT
        range 1 3600
        default 32
        help
          After a link loss the first reconnect is immediate and later ones
          double from 1 s up to this interval.

    config CORE2FORAWS_WIFI_PROVISIONING
        bool "BLE Wi-Fi provisioning"
        depends on SOFTWARE_WIFI_SUPPORT && BT_ENABLED
        default y
        help
          Build core2foraws_wifi_prov.h so a phone app can send Wi-Fi
          credentials over BLE. Disable to drop the provisioning manager.

    config CORE2FORAWS_WIFI_PROV_MAX_FAILS
        int "Failed phone credential attempts before provisioning resets"
        depends on CORE2FORAWS_WIFI_PROVISIONING
        range 1 20
        default 5
        help
          After this many consecutive failed credential attempts from the
          phone, the provisioning state machine resets so the phone can retry.

    config CORE2FORAWS_WIFI_PROV_CONSOLE_QR
        bool "Print the provisioning QR code to the console"
        depends on CORE2FORAWS_WIFI_PROVISIONING
        default y
        help
          Print a QR code and URL for the provisioning app when a session
          opens. Applications can instead render the payload from
          core2foraws_wifi_provisioning_payload_get().

    config CORE2FORAWS_WIFI_RELEASE_BLE_WHEN_PROVISIONED
        bool "Release BLE controller memory once Wi-Fi connects"
        depends on CORE2FORAWS_WIFI_PROVISIONING
        default n
        help
          Frees the Bluetooth controller's reserved internal DRAM, typically
          tens of KB, once the station connects outside a provisioning session
          or when a provisioning session ends. This is the largest single lever
          for LVGL draw-buffer headroom.

          Once released, BLE cannot be used again until the next reboot, so
          core2foraws_wifi_provisioning_start() returns ESP_ERR_NOT_SUPPORTED.
          Leave this disabled if the application uses BLE for anything else or
          must re-provision without restarting.

endmenu
```

## lib/button/Kconfig
```kconfig
# SPDX-FileCopyrightText: 2022 Rashed Talukder
# SPDX-FileCopyrightText: 2022 M5Stack
# SPDX-License-Identifier: MIT

menu "Virtual touch buttons"
    depends on SOFTWARE_DISPLAY_SUPPORT && SOFTWARE_BUTTON_SUPPORT

    config CORE2FORAWS_BUTTON_DEBOUNCE_MS
        int "Virtual button debounce time (ms)"
        default 10
        range 0 200
        help
        Minimum time that a press or release state must remain stable before
        the virtual button driver accepts the transition.
endmenu
```

## lib/display/Kconfig
```kconfig
# SPDX-FileCopyrightText: 2022 Rashed Talukder
# SPDX-FileCopyrightText: 2022 M5Stack
# SPDX-License-Identifier: MIT

# Display Kconfig
# LVGL is now provided as a managed component (lvgl/lvgl via idf_component.yml).
# LVGL's own Kconfig is exposed automatically by the component manager.

config CORE2FORAWS_LCD_DRAW_BUF_LINES
    int "LVGL draw buffer height (display lines)"
    depends on SOFTWARE_DISPLAY_SUPPORT
    range 10 60
    default 20
    help
      Height, in display lines, of each LVGL draw buffer. The driver allocates
      two of these (double buffering) as RGB565, so the internal DMA-capable
      DRAM cost is:

          lines * 320 * 2 bytes * 2 buffers

      At the default of 20 lines that is 25,600 bytes, and each buffer needs a
      single *contiguous* 12,800-byte DMA block. Contiguity, not total free
      heap, is what typically fails once Wi-Fi and BLE are running.

      Larger values reduce the number of partial transfers per frame and raise
      throughput. Lower this if display initialization reports insufficient
      DMA-capable DRAM; raise it if your application leaves internal DRAM to
      spare.

      These buffers must stay in internal DRAM; PSRAM is not DMA-addressable
      and is not a fallback. See the memory budget section of the BSP README.
```

## tests/hardware/sdkconfig.defaults
```kconfig
CONFIG_ESPTOOLPY_FLASHSIZE_16MB=y
CONFIG_ESPTOOLPY_FLASHFREQ_80M=y
CONFIG_ESP_DEFAULT_CPU_FREQ_MHZ_240=y
CONFIG_SPIRAM=y
CONFIG_SPIRAM_BOOT_INIT=y
CONFIG_SPIRAM_USE_MALLOC=y
CONFIG_SPIRAM_SPEED_80M=y
CONFIG_SPIRAM_MALLOC_ALWAYSINTERNAL=4096
CONFIG_SPIRAM_MALLOC_RESERVE_INTERNAL=32768
CONFIG_SPIRAM_TRY_ALLOCATE_WIFI_LWIP=y
CONFIG_BT_ENABLED=y
CONFIG_BT_NIMBLE_ENABLED=y
CONFIG_ESP_PROTOCOMM_SUPPORT_SECURITY_VERSION_1=y
CONFIG_MBEDTLS_EXTERNAL_MEM_ALLOC=y
CONFIG_SOFTWARE_BSP_SUPPORT=y
CONFIG_SOFTWARE_AUDIO_SUPPORT=y
CONFIG_SOFTWARE_BUTTON_SUPPORT=y
CONFIG_SOFTWARE_CRYPTO_SUPPORT=y
CONFIG_SOFTWARE_DISPLAY_SUPPORT=y
CONFIG_SOFTWARE_EXPANSION_PORTS_SUPPORT=y
CONFIG_SOFTWARE_MOTION_SUPPORT=y
CONFIG_SOFTWARE_RGB_LED_SUPPORT=y
CONFIG_SOFTWARE_RTC_SUPPORT=y
CONFIG_SOFTWARE_SDCARD_SUPPORT=y
CONFIG_SOFTWARE_WIFI_SUPPORT=y
CONFIG_CORE2FORAWS_LCD_DRAW_BUF_LINES=20
CONFIG_LV_COLOR_FORMAT_RGB565_SWAPPED=y
CONFIG_LV_USE_CLIB_MALLOC=y
CONFIG_ATECC608A_TNG=y
CONFIG_ATCA_I2C_SDA_PIN=21
CONFIG_ATCA_I2C_SCL_PIN=22
CONFIG_ATCA_I2C_ADDRESS=0x6A
CONFIG_PARTITION_TABLE_CUSTOM=y
CONFIG_PARTITION_TABLE_CUSTOM_FILENAME="partitions.csv"
```
