## Alexa_for_IoT-Intro/components/ulp_adc/Kconfig
```kconfig
menu "ULP_ADC"
    depends on ESP32_ULP_COPROC_ENABLED

    config  ULP_REL_ADC_CHANNEL
    int "ADC1 channel monitoring relative difference crossings"
    range 0 7
    default 3
    depends on ESP32_ULP_COPROC_ENABLED
    help
        ADC1 channel which polls ADC value and generates interrupt when ADC reading
        greater than relative difference

        |current - prev| > relative_thres

        Ex. Polling multiple buttons connected on single ADC channel

    config ULP_ABS_ADC_CHANNEL_ENABLE
    bool "Enable ADC1 channel for absolute ADC monitoring"
    help
        If enabled, ADC1 channel will monitor ADC readings crossing absolute ADC thresholds

        Ex. Monitoring battery voltage

    config ULP_ABS_ADC_CHANNEL
    int "ADC1 channel monitoring absolute threshold crossings"
    range 0 7
    default 6
    depends on ULP_ABS_ADC_CHANNEL_ENABLE
    help
        ADC1 channel which polls ADC value and generates interrupt when ADC reading
        goes below or above the thresholds specified

        ADC reading < abs_thres_low  or ADC reading > abs_thres_high
endmenu
```

## Alexa_for_IoT-Intro/sdkconfig.defaults
```kconfig
#
# Serial flasher config
#
CONFIG_ESPTOOLPY_BAUD_921600B=y
CONFIG_ESPTOOLPY_BAUD=921600
CONFIG_ESPTOOLPY_FLASHMODE_QIO=y
CONFIG_ESPTOOLPY_FLASHMODE="dio"
CONFIG_ESPTOOLPY_FLASHFREQ_80M=y
CONFIG_ESPTOOLPY_FLASHFREQ="80m"
CONFIG_ESPTOOLPY_FLASHSIZE_16MB=y
CONFIG_ESPTOOLPY_FLASHSIZE="16MB"
CONFIG_ESPTOOLPY_FLASHSIZE_DETECT=y

#
# Partition Table
#
CONFIG_PARTITION_TABLE_CUSTOM=y
CONFIG_PARTITION_TABLE_CUSTOM_FILENAME="partitions.csv"
CONFIG_PARTITION_TABLE_FILENAME="partitions.csv"

#
# Voice Assistant Configurations
#
CONFIG_ALEXA_PRODUCT_ID="esp_alexa_open"

#
# Compiler options
#
CONFIG_COMPILER_OPTIMIZATION_LEVEL_RELEASE=y

#
# ESP32-specific
#
CONFIG_ESP32_DEFAULT_CPU_FREQ_240=y
CONFIG_ESP32_DEFAULT_CPU_FREQ_MHZ=240
CONFIG_ESP32_SPIRAM_SUPPORT=y

#
# SPI RAM config
#
CONFIG_SPIRAM_BOOT_INIT=y
CONFIG_SPIRAM_USE_MALLOC=y
CONFIG_SPIRAM_SPEED_80M=y
CONFIG_SPIRAM_MEMTEST=y
CONFIG_SPIRAM_CACHE_WORKAROUND=y
CONFIG_SPIRAM_MALLOC_ALWAYSINTERNAL=8190
CONFIG_SPIRAM_TRY_ALLOCATE_WIFI_LWIP=y
CONFIG_SPIRAM_MALLOC_RESERVE_INTERNAL=32768
CONFIG_SPIRAM_ALLOW_STACK_EXTERNAL_MEMORY=y
CONFIG_SPIRAM_BANKSWITCH_ENABLE=n

#
# ESP Specific
#
CONFIG_ESP_SYSTEM_EVENT_TASK_STACK_SIZE=4096
CONFIG_ESP_MAIN_TASK_STACK_SIZE=6144
CONFIG_ESP_TIMER_TASK_STACK_SIZE=4096
CONFIG_ESP32_PANIC_GDBSTUB=y
CONFIG_ESP_TASK_WDT_PANIC=y
CONFIG_SPIRAM_ALLOW_BSS_SEG_EXTERNAL_MEMORY=y

#
# AWS-IoT
#
CONFIG_AWS_IOT_SDK=y
CONFIG_AWS_IOT_MQTT_TX_BUF_LEN=8704
CONFIG_AWS_IOT_MQTT_RX_BUF_LEN=8704
CONFIG_AWS_IOT_MQTT_NUM_SUBSCRIBE_HANDLERS=10
CONFIG_AWS_IOT_SHADOW_MAX_SIZE_OF_THING_NAME=40

#
# Wi-Fi
#
CONFIG_ESP32_WIFI_STATIC_TX_BUFFER_NUM=32
CONFIG_ESP32_WIFI_STATIC_TX_BUFFER=y
CONFIG_ESP32_WIFI_TX_BUFFER_TYPE=0
CONFIG_ESP32_WIFI_STATIC_RX_BUFFER_NUM=10
CONFIG_ESP32_WIFI_DYNAMIC_RX_BUFFER_NUM=32

#
# Bluetooth
#
CONFIG_BT_ENABLED=y

#
# Bluetooth controller
#
CONFIG_BTDM_CTRL_MODE_BLE_ONLY=y
CONFIG_BT_STACK_NO_LOG=y

#
# ESP HTTP client
#
CONFIG_ESP_HTTP_CLIENT_ENABLE_HTTPS=y

#
# FreeRTOS
#
CONFIG_FREERTOS_IDLE_TASK_STACKSIZE=1024
CONFIG_FREERTOS_SUPPORT_STATIC_ALLOCATION=y
CONFIG_FREERTOS_TIMER_TASK_STACK_DEPTH=6144
CONFIG_FREERTOS_USE_TRACE_FACILITY=y
CONFIG_FREERTOS_WATCHPOINT_END_OF_STACK=y
CONFIG_FREERTOS_CHECK_MUTEX_GIVEN_BY_OWNER=n

#
# Log output
#
CONFIG_LOG_DEFAULT_LEVEL_INFO=y
CONFIG_LOG_DEFAULT_LEVEL=3

#
# LWIP
#
CONFIG_LWIP_LOCAL_HOSTNAME="Core2ForAWS"
CONFIG_LWIP_MAX_SOCKETS=9
CONFIG_LWIP_USE_ONLY_LWIP_SELECT=y
CONFIG_LWIP_ETHARP_TRUST_IP_MAC=y
CONFIG_LWIP_DHCP_MAX_NTP_SERVERS=3

#
# TCP
#
CONFIG_LWIP_MAX_ACTIVE_TCP=8
CONFIG_LWIP_MAX_LISTENING_TCP=8
CONFIG_LWIP_TCP_SND_BUF_DEFAULT=14360
CONFIG_LWIP_TCP_WND_DEFAULT=14360
CONFIG_LWIP_TCP_RECVMBOX_SIZE=12

#
# PThreads
#
CONFIG_PTHREAD_TASK_PRIO_DEFAULT=4
CONFIG_PTHREAD_TASK_STACK_SIZE_DEFAULT=16000

#
# mbedTLS
#
# CONFIG_MBEDTLS_HAVE_TIME=y
# CONFIG_MBEDTLS_HAVE_TIME_DATE=y
CONFIG_MBEDTLS_EXTERNAL_MEM_ALLOC=y
CONFIG_MBEDTLS_HARDWARE_AES=n

#
# Core2 for AWS hardware enable
#
CONFIG_SOFTWARE_ILI9342C_SUPPORT=y
CONFIG_SOFTWARE_FT6336U_SUPPORT=y
CONFIG_SOFTWARE_SK6812_SUPPORT=y
CONFIG_SOFTWARE_ATECC608_SUPPORT=y
CONFIG_SOFTWARE_BUTTON_SUPPORT=
CONFIG_SOFTWARE_MPU6886_SUPPORT=
CONFIG_SOFTWARE_SPEAKER_SUPPORT=
CONFIG_SOFTWARE_MIC_SUPPORT=
CONFIG_SOFTWARE_RTC_SUPPORT=
CONFIG_SOFTWARE_SDCARD_SUPPORT=
CONFIG_SOFTWARE_EXPPORTS_SUPPORT=
```

## Blinky-Hello-World/components/esp-cryptoauthlib/esp_cryptoauth_utility/firmware/sdkconfig.defaults
```kconfig
CONFIG_ESP_TASK_WDT=n
CONFIG_ESPTOOLPY_FLASHSIZE_2MB=y
CONFIG_ESPTOOLPY_FLASHFREQ_80M=y
CONFIG_VFS_SUPPORT_TERMIOS=n
CONFIG_ESP_SYSTEM_PANIC_PRINT_HALT=y
CONFIG_ESP_ERR_TO_NAME_LOOKUP=n
CONFIG_ESP_DEBUG_STUBS_ENABLE=n
CONFIG_NEWLIB_NANO_FORMAT=y
CONFIG_WPA_MBEDTLS_CRYPTO=n
CONFIG_MBEDTLS_TLS_SERVER_AND_CLIENT=n
CONFIG_MBEDTLS_CERTIFICATE_BUNDLE=n
CONFIG_MBEDTLS_SHA512_C=n
CONFIG_MBEDTLS_CCM_C=n
CONFIG_MBEDTLS_TLS_DISABLED=y
CONFIG_MBEDTLS_ASYMMETRIC_CONTENT_LEN=n
CONFIG_MBEDTLS_SSL_KEEP_PEER_CERTIFICATE=n
CONFIG_MBEDTLS_ECP_DP_SECP192R1_ENABLED=n
CONFIG_MBEDTLS_ECP_DP_SECP224R1_ENABLED=n
CONFIG_MBEDTLS_ECP_DP_SECP384R1_ENABLED=n
CONFIG_MBEDTLS_ECP_DP_SECP521R1_ENABLED=n
CONFIG_MBEDTLS_ECP_DP_SECP192K1_ENABLED=n
CONFIG_MBEDTLS_ECP_DP_SECP224K1_ENABLED=n
CONFIG_MBEDTLS_ECP_DP_BP384R1_ENABLED=n
CONFIG_MBEDTLS_ECP_DP_BP512R1_ENABLED=n
CONFIG_MBEDTLS_ECP_DP_CURVE25519_ENABLED=n
CONFIG_MBEDTLS_ECP_DP_BP256R1_ENABLED=n
CONFIG_MBEDTLS_ECP_DP_SECP256K1_ENABLED=n
CONFIG_APP_BUILD_TYPE_ELF_RAM=y
```

## Blinky-Hello-World/main/Kconfig.projbuild
```kconfig
menu "AWS IoT EduKit Configuration"

    config WIFI_SSID
        string "WiFi SSID"
        default "AWSWorkshop"
        help
            SSID (network name) for the example to connect to.

    config WIFI_PASSWORD
        string "WiFi Password"
        default "IoTP$AK1t"
        help
            WiFi password (WPA or WPA2) for the example to use.

            Can be left blank if the network has no security set.

endmenu
```

## Core2-for-AWS-IoT-EduKit-Factory-Firmware/components/core2forAWS/tft/Kconfig
```kconfig
menu "LVGL TFT Display controller"

    config LV_DISPLAY_WIDTH
        int "TFT display width in pixels." 
        default 320

    config LV_DISPLAY_HEIGHT
        int "TFT display height in pixels." 
        default 240
    
    config LV_TFT_DISPLAY_CONTROLLER_ILI9341
        int "TFT Types" 
        default 1
endmenu
```

## Factory-Firmware/sdkconfig.defaults
```kconfig
#
# Enable TLS asymmetric in/out content length
#
CONFIG_MBEDTLS_ASYMMETRIC_CONTENT_LEN=y


#
# Partition Table
#
CONFIG_PARTITION_TABLE_CUSTOM=y
CONFIG_PARTITION_TABLE_CUSTOM_FILENAME="partitions_16MB.csv"
CONFIG_PARTITION_TABLE_FILENAME="partitions_16MB.csv"
CONFIG_PARTITION_TABLE_OFFSET=0x8000
CONFIG_PARTITION_TABLE_MD5=y
# end of Partition Table

#
# Serial flasher config
#
CONFIG_ESPTOOLPY_FLASHMODE_QIO=y
CONFIG_ESPTOOLPY_FLASHMODE="qio"
CONFIG_ESPTOOLPY_FLASHFREQ_80M=y
CONFIG_ESPTOOLPY_FLASHFREQ="80m"
CONFIG_ESPTOOLPY_FLASHSIZE_16MB=y
CONFIG_ESPTOOLPY_FLASHSIZE="16MB"
CONFIG_ESPTOOLPY_FLASHSIZE_DETECT=y

#
# ESP32-specific
#
CONFIG_ESP32_ECO3_CACHE_LOCK_FIX=y
CONFIG_ESP32_REV_MIN_3=y
CONFIG_ESP32_REV_MIN=3
CONFIG_ESP32_DEFAULT_CPU_FREQ_240=y
CONFIG_ESP32_DEFAULT_CPU_FREQ_MHZ=240
CONFIG_ESP32_SPIRAM_SUPPORT=y

#
# For BLE Provisioning using NimBLE stack (ESP32 only)
#
CONFIG_BT_ENABLED=y
CONFIG_BTDM_CTRL_MODE_BLE_ONLY=y
CONFIG_BT_NIMBLE_ENABLED=y
CONFIG_BT_NIMBLE_MEM_ALLOC_MODE_EXTERNAL=y

#
# SPI RAM config
#
CONFIG_SPIRAM_TYPE_AUTO=y
CONFIG_SPIRAM_SIZE=-1
CONFIG_SPIRAM_SPEED_80M=y
CONFIG_SPIRAM=y
CONFIG_SPIRAM_BOOT_INIT=y
CONFIG_SPIRAM_USE_MALLOC=y
CONFIG_SPIRAM_MEMTEST=y
CONFIG_SPIRAM_MALLOC_ALWAYSINTERNAL=16384
CONFIG_SPIRAM_TRY_ALLOCATE_WIFI_LWIP=y
CONFIG_SPIRAM_MALLOC_RESERVE_INTERNAL=32768
CONFIG_SPIRAM_ALLOW_BSS_SEG_EXTERNAL_MEMORY=y
CONFIG_SPIRAM_CACHE_WORKAROUND=
CONFIG_SPIRAM_BANKSWITCH_ENABLE=y
CONFIG_SPIRAM_BANKSWITCH_RESERVE=8
CONFIG_D0WD_PSRAM_CLK_IO=17
CONFIG_D0WD_PSRAM_CS_IO=16

#
# ESP-TLS
#
CONFIG_ESP_TLS_USING_MBEDTLS=y
CONFIG_ESP_TLS_USE_SECURE_ELEMENT=y

#
# LWIP
#
CONFIG_LWIP_LOCAL_HOSTNAME="Core2ForAWS"

#
# SPI Flash driver
#
CONFIG_SPI_FLASH_SUPPORT_ISSI_CHIP=y
CONFIG_SPI_FLASH_SUPPORT_MXIC_CHIP=y
CONFIG_SPI_FLASH_SUPPORT_GD_CHIP=y

#
# LVGL configuration
#

#
# Enable built-in fonts
#
CONFIG_LV_FONT_MONTSERRAT_12=y
CONFIG_LV_FONT_MONTSERRAT_14=y
CONFIG_LV_FONT_MONTSERRAT_16=y
CONFIG_LV_FONT_MONTSERRAT_18=y
CONFIG_LV_FONT_DEFAULT_SMALL_MONTSERRAT_12=y
# end of Enable built-in fonts

CONFIG_LV_FONT_DEFAULT_SMALL_MONTSERRAT_12=y
CONFIG_LV_FONT_DEFAULT_NORMAL_MONTSERRAT_16=y
CONFIG_LV_FONT_DEFAULT_SUBTITLE_MONTSERRAT_14=y
CONFIG_LV_FONT_DEFAULT_TITLE_MONTSERRAT_18=y

# end of Font usage

#
# Core2 for AWS hardware enable
#
CONFIG_SOFTWARE_ILI9342C_SUPPORT=y
CONFIG_SOFTWARE_FT6336U_SUPPORT=y
CONFIG_SOFTWARE_SK6812_SUPPORT=y
CONFIG_SOFTWARE_ATECC608_SUPPORT=y
CONFIG_SOFTWARE_BUTTON_SUPPORT=y
CONFIG_SOFTWARE_MPU6886_SUPPORT=y
CONFIG_SOFTWARE_SPEAKER_SUPPORT=y
CONFIG_SOFTWARE_MIC_SUPPORT=y
CONFIG_SOFTWARE_RTC_SUPPORT=y
CONFIG_SOFTWARE_SDCARD_SUPPORT=

#
# esp-cryptoauthlib
#
CONFIG_ATECC608A_TNG=y
CONFIG_ATECC608A_TFLEX=
CONFIG_ATECC608A_TCUSTOM=
CONFIG_ATCA_MBEDTLS_ECDSA=y
CONFIG_ATCA_MBEDTLS_ECDSA_SIGN=y
CONFIG_ATCA_MBEDTLS_ECDSA_VERIFY=y
CONFIG_ACTA_I2C_SDA_PIN=21
CONFIG_ACTA_I2C_SCL_PIN=22
```

## Getting-Started/components/esp-cryptoauthlib/esp_cryptoauth_utility/firmware/sdkconfig.defaults.esp32
```kconfig
CONFIG_ESP32_DEFAULT_CPU_FREQ_240=y
CONFIG_COMPILER_OPTIMIZATION_SIZE=y
CONFIG_COMPILER_OPTIMIZATION_ASSERTIONS_SILENT=y
# Following option is only applicable for esp32
CONFIG_ESP_SYSTEM_ESP32_SRAM1_REGION_AS_IRAM=y
```

## Hardware-Features-Demo/components/esp-cryptoauthlib/esp_cryptoauth_utility/firmware/main/Kconfig.projbuild
```kconfig
menu "ECU Configurations"

config ECU_DEBUGGING
    bool "esp_cryptoauth_utility Debug"
	default y
	help
		Turn on debug logs for the esp_cryptoauth_utility.

endmenu
```

## Hardware-Features-Demo/components/esp-cryptoauthlib/esp_cryptoauth_utility/firmware/sdkconfig.defaults.esp32p4
```kconfig
CONFIG_COMPILER_OPTIMIZATION_SIZE=y
CONFIG_COMPILER_OPTIMIZATION_ASSERTIONS_DISABLE=y
CONFIG_ESP_CONSOLE_USB_SERIAL_JTAG=y
CONFIG_MBEDTLS_HARDWARE_SHA=n
CONFIG_COMPILER_OPTIMIZATION_CHECKS_SILENT=y
CONFIG_COMPILER_SAVE_RESTORE_LIBCALLS=y
CONFIG_ESP_SYSTEM_PANIC_SILENT_REBOOT=y
```

## Smart-Thermostat/components/esp-cryptoauthlib/esp_cryptoauth_utility/firmware/sdkconfig.defaults.esp32c2
```kconfig
CONFIG_COMPILER_OPTIMIZATION_SIZE=y
CONFIG_COMPILER_OPTIMIZATION_ASSERTIONS_DISABLE=y
CONFIG_COMPILER_OPTIMIZATION_CHECKS_SILENT=y
```
